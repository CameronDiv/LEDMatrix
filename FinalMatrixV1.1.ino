#include "FastLED.h"                            //Library that Controls the LED Matrix

//Constant variables that may need to be set before uploading
#define LED_PIN  3                              //Arduino Output Pin that connects to Matrix Data In Pin
#define CHIPSET     WS2812B                     //Type of LED
#define COLOR_ORDER GRB                         //Order of the RGB values
#define BRIGHTNESS 64                           //Brightness of the LEDs
const uint8_t kMatrixWidth = 16;                //Sets the width of your matrix
const uint8_t kMatrixHeight = 16;               //Sets the height of your matrix
#define NUM_LEDS (kMatrixWidth * kMatrixHeight) //Total number of LEDs in your matrix
CRGB leds[NUM_LEDS];                            //Refer to FastLED library for this line
const int buttonInputPin = 2;                   //Picks digital Pin 2 as the input for the button
const int pauseLight = 4;                       //Digital Pin that will power an LED to indicate if pause is on/off
//CRGBPalette16 currentPalette;
//TBlendType    currentBlending;


//variables that can change value during run time
int caseSelector = 0;                   //Picks which case # to execute
int caseMax = 10;                        //The total number of cases add 1 to the total (i.e. case 5 is the last case so caseMax = 6)
int lastButtonState = LOW;              //Variable used to prevent toggling the pauseState more than once per button press
int buttonState;                        //The current state of the buttonInputPin
bool pauseState = false;                //pauseState changes when the button is pressed toggles between 1 (Pause On) and 0 (Pause off)
unsigned long delayTime = 5000;         //length of the delay in milliseconds (i.e. 1000millis = 1 second)
unsigned long variableDelayTime = 2000;  //A default time delay for animated images that can be changed during the loop (200millis = .2 seconds)
unsigned long previousTime = 0;         //Stores the last time update
unsigned long currentTime = 0;          //Stores value of the currentTime

//Bitmaps to display on the LED Matrix
//Stored in memory of the Arduino to save space for the dynamic memory
const long Cat[] PROGMEM =
{
0x7ecc79,0x7ecc79,0x7ecc79,0x7ecc79,0x7ecc79,0x7ecc79,0x7ecc79,0x474747,0x7ecc79,0x7ecc79,0x7ecc79,0x7ecc79,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0x6b6b6b

};

const long Dog[] PROGMEM =
{
0xde8d86,0xde8d86,0xde8d86,0xde8d86,0xde8d86,0xde8d86,0xde8d86,0xde8d86,0xde8d86,0xde8d86,0xde8d86,0xde8d86,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0xde8d86

};

const long Apple[] PROGMEM =
{
0xffffff,0xffffff,0xffffff,0xffffff,0xffffff,0xffffff,0xffffff,0xffffff,0xffffff,0xffffff,0xffffff,0xffffff,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0xffffff

};

const long Tree[] PROGMEM =
{
0x43b8d8,0x43b8d8,0x43b8d8,0x02a000,0x02a000,0x02a000,0x02a000,0x02a000,0x02a000,0x02a000,0x02a000,0x02a000,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0x04ff00

};
const long BirthdayMom[] PROGMEM =
{
0x000000,0x00c0ff,0x000000,0x00c0ff,0x5eff00,0x5eff00,0x5eff00,0xffee00,0xffee00,0xffee00,0xff4a00,0xff4a00,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0x9e00ff

};
const long Butterfly[] PROGMEM =
{
0xb5b5b5,0xb5b5b5,0xb5b5b5,0xb5b5b5,0xb5b5b5,0xb5b5b5,0xb5b5b5,0xb5b5b5,0xb5b5b5,0xb5b5b5,0xb5b5b5,0xb5b5b5,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0xb5b5b5

};
const long Cactus[] PROGMEM =
{
0xffffff,0xffffff,0xffffff,0xffffff,0xffffff,0xffffff,0xffffff,0xffffff,0xffffff,0xffffff,0xffffff,0xffffff,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0xffffff

};
const long Rainbow[] PROGMEM =
{
0xa2deff,0xa2deff,0xa2deff,0xa2deff,0xa2deff,0xa2deff,0xa2deff,0xa2deff,0xa2deff,0xa2deff,0xa2deff,0xa2deff,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0xa2deff

};
const long Duck[] PROGMEM =
{
0x7ee2dc,0x7ee2dc,0x7ee2dc,0x7ee2dc,0x7ee2dc,0x7ee2dc,0x7ee2dc,0x7ee2dc,0x7ee2dc,0x7ee2dc,0x7ee2dc,0x7ee2dc,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0x1a6eff

};
const long Frog[] PROGMEM =
{
0x259fb5,0x259fb5,0x259fb5,0x259fb5,0x3b5525,0x3b5525,0x259fb5,0x259fb5,0x259fb5,0x259fb5,0x3b5525,0x3b5525,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0x259fb5

};


//Setup that uses the defined variables and values above
void setup() {
  FastLED.addLeds<CHIPSET, LED_PIN, COLOR_ORDER>(leds, NUM_LEDS); // GRB ordering is typical
  FastLED.setBrightness( BRIGHTNESS );                            //Sets the brightness for the LED's
  pinMode(buttonInputPin, INPUT);                                 //Declare buttonInputPin as an INPUT
  pinMode(pauseLight, OUTPUT);                                    //Declare pauseLight as an OUTPUT

  //Serial.begin(9600);                     //Uncomment this and anyting else that begins with Serial to help troubleshooting (Hopefully this will not be necessary)
}

void loop() 
{
  buttonCheck();                            //Check to see if pause button was pressed and toggles pause light
  standardDelay();                          //Delay before the case (image being displayed) changes
  switch (caseSelector)
  {

    case 0:
      FastLED.setCorrection(UncorrectedColor);  //Brightness Correction changes individual RGB color values
      for (int i = 0; i < NUM_LEDS; i++) 
      {
        leds[i] = pgm_read_dword(&(BirthdayMom[i]));  // Read array from Flash
      }
      adjustGamma();                            //Very Basic color correction to help match colors of original image
      FastLED.show();                           //Displays the image on the Matrix
    break;
  
    case 1:
      FastLED.setCorrection(UncorrectedColor);  //Brightness Correction changes individual RGB color values
      for (int i = 0; i < NUM_LEDS; i++) 
      {
        leds[i] = pgm_read_dword(&(Dog[i]));  // Read array from Flash
      }
      adjustGamma();                            //Very Basic color correction to help match colors of original image
      FastLED.show();                           //Displays the image on the Matrix
    break;
    
    case 2:
      FastLED.setCorrection(UncorrectedColor);  //Brightness Correction changes individual RGB color values
      for (int i = 0; i < NUM_LEDS; i++) 
      {
        leds[i] = pgm_read_dword(&(Cat[i]));  // Read array from Flash
      }
      adjustGamma();                            //Very Basic color correction to help match colors of original image
      FastLED.show();                           //Displays the image on the Matrix
    break;
    
    case 3:
      FastLED.setCorrection(UncorrectedColor);  //Brightness Correction changes individual RGB color values
      for (int i = 0; i < NUM_LEDS; i++) 
      {
        leds[i] = pgm_read_dword(&(Frog[i]));  // Read array from Flash
      }
      adjustGamma();                            //Very Basic color correction to help match colors of original image
      FastLED.show();                           //Displays the image on the Matrix
    break;
        
    case 4:
      FastLED.setCorrection(UncorrectedColor);  //Brightness Correction changes individual RGB color values
      for (int i = 0; i < NUM_LEDS; i++) 
      {
        leds[i] = pgm_read_dword(&(Tree[i]));  // Read array from Flash
      }
      adjustGamma();                            //Very Basic color correction to help match colors of original image
      FastLED.show();                           //Displays the image on the Matrix
    break;
        
    case 5:
      FastLED.setCorrection(UncorrectedColor);  //Brightness Correction changes individual RGB color values
      for (int i = 0; i < NUM_LEDS; i++) 
      {
        leds[i] = pgm_read_dword(&(Apple[i]));  // Read array from Flash
      }
      adjustGamma();                            //Very Basic color correction to help match colors of original image
      FastLED.show();                           //Displays the image on the Matrix
    break;
        
    case 6:
      FastLED.setCorrection(UncorrectedColor);  //Brightness Correction changes individual RGB color values
      for (int i = 0; i < NUM_LEDS; i++) 
      {
        leds[i] = pgm_read_dword(&(Rainbow[i]));  // Read array from Flash
      }
      adjustGamma();                            //Very Basic color correction to help match colors of original image
      FastLED.show();                           //Displays the image on the Matrix
    break;
        
    case 7:
      FastLED.setCorrection(UncorrectedColor);  //Brightness Correction changes individual RGB color values
      for (int i = 0; i < NUM_LEDS; i++) 
      {
        leds[i] = pgm_read_dword(&(Butterfly[i]));  // Read array from Flash
      }
      adjustGamma();                            //Very Basic color correction to help match colors of original image
      FastLED.show();                           //Displays the image on the Matrix
    break;
        
    case 8:
      FastLED.setCorrection(UncorrectedColor);  //Brightness Correction changes individual RGB color values
      for (int i = 0; i < NUM_LEDS; i++) 
      {
        leds[i] = pgm_read_dword(&(Cactus[i]));  // Read array from Flash
      }
      adjustGamma();                            //Very Basic color correction to help match colors of original image
      FastLED.show();                           //Displays the image on the Matrix
    break;
    
    case 9:
      FastLED.setCorrection(UncorrectedColor);
      for (int j = 15; j > -1; j--)               //Shifting an image from right to left and wrapping it around
      {
        int k = 0;                                //Reset k  (row indicator)            
        for (int i = 0; i < NUM_LEDS; i++) 
        {
          if (i%16 == 0)                          //Increasing k everytime i is a multiple of 16 and when i is 0
          {
            k = (k+1)% kMatrixHeight;             //Makes sure k cannot go over the max amount of rows
          }       
          if (k%2 == 1)                           //Check to see if k is odd or even row (This is the odd row check)
          {

            if (i+j < kMatrixHeight*k)                       
            {
            leds[i] = pgm_read_dword(&(Duck[i+j]));    // Read array from Flash
            //Serial.print("k=1 -> i = ");
            //Serial.println(i+j); 
            }

            else
            {
            leds[i] = pgm_read_dword(&(Duck[i+j-16])); // Read array from Flash
            //Serial.print("else k=1 -> i = ");
            //Serial.println(i+j-16); 
            }
          }

          if (k%2 == 0)                           //Check to see if k is odd or even row (This is the even row check)
          {
            if (i+16-j >= kMatrixHeight*k)
            {
              leds[i] = pgm_read_dword(&(Duck[i-j]));  // Read array from Flash
              //Serial.print("k=0 -> i = ");
              //Serial.println(i-j); 
            }
            
            else
            {
              leds[i] = pgm_read_dword(&(Duck[i+16-j])); // Read array from Flash
              //Serial.print("else k=0 i = ");
              //Serial.println(i+16-j);  
            }            
          }

        }
        adjustGamma();
        FastLED.show();
        variableDelay();
      }
    break;
  }
}

//Function that does some basic color correction
//3 different dim8_ versions (dim8_video,dim8_lin,dim8_raw)
//dim8_video worked best for my project but results may vary
void adjustGamma()
{
  for (uint16_t i = 0; i < NUM_LEDS; i++)
  {
  leds[i].r = dim8_video(leds[i].r);
  leds[i].g = dim8_video(leds[i].g);
  leds[i].b = dim8_video(leds[i].b);
  }
}


//Function to if the Button was pressed (uses a falling edge trigger)
//Recommend a pulldown resistor to make sure the buttonState isn't floating
void buttonCheck()
{
  buttonState = digitalRead(buttonInputPin);
  if (buttonState != lastButtonState)
  {
    if (buttonState == HIGH)
    {
      pauseState = !pauseState;
      if (pauseState == true)
        {
          digitalWrite(pauseLight,HIGH);
        }
      else
      {
        digitalWrite(pauseLight,LOW);  
      }
    }
    delay(20);
  }    
  lastButtonState = buttonState;
}


//Function increments the caseSelector and keeps the case number in the proper bounds
void pauseCheck()
{
  if (pauseState == false)
  {
    caseSelector = caseSelector + 1;
    caseSelector = caseSelector % caseMax;
  }
}


//Function to delay the Arduino without using delay
//Arduino delay function basically pauses the code and is bad for buttonchecks
void standardDelay()
{
//  currentTime = millis();
//  if (currentTime - previousTime >= delayTime)
//  {
//    previousTime = currentTime;
//    pauseCheck();
//  }
    while (delayTime >= currentTime - previousTime)
  {
    buttonCheck();
    currentTime = millis();
  }
  previousTime = currentTime;
  pauseCheck();
}


//Function to delay the Arduino without using delay
//Arduino delay function basically pauses the code and is bad for buttonchecks
void variableDelay()
{
  //previousTime = millis();

  while (variableDelayTime >= currentTime - previousTime)
  {
    buttonCheck();
    currentTime = millis();
  }
  previousTime = currentTime;
}


//Function that runs buttonCheck and stardardDelay
//Put this at the end of a case statement that displays only one image (i.e. not animated)
void staticImageDelay()
{
  buttonCheck();
  standardDelay();
}
